## drivers/power/supply/bq25910-slave/Kconfig
```kconfig
config CHARGER_BQ25910_SLAVE
	tristate "TI BQ25910 battery charger driver"
	depends on I2C
	default n
	help
	  Say Y to enable support for TI bq25910 as slave charger
```
